// Copyright 2022 Raymond Cardillo dba Cardillo's Creations, LLC
//
// Licensed under the Apache License, Version 2.0 (the "License");
// you may not use this file except in compliance with the License.
// You may obtain a copy of the License at
//
//   http://www.apache.org/licenses/LICENSE-2.0
//
// Unless required by applicable law or agreed to in writing, software
// distributed under the License is distributed on an "AS IS" BASIS,
// WITHOUT WARRANTIES OR CONDITIONS OF ANY KIND, either express or implied.
// See the License for the specific language governing permissions and
// limitations under the License.

//////////
// agbgtc_tinyusb.ino
//////////
//
// Automatic Game Builder Garage Texture Creator
// TinyUSB variant tested on Seeeduino XIAO.
//
// See README.md for more details.
//
// Developed and tested with:
// - Arduino IDE          = v2.0.0-rc5
// - Seeeduino XIAO Board = v1.8.2
// - Adafruit_TinyUSB     = v0.10.5
// - ^^ DO NOT USE v1.x.x until Seeeduino updates their board library (breaking change)
//
// Author of TinyUSB variant (tested on Seeeduino XIAO):
// Ray Cardillo / LongToothGamer
// https://LongToothGamer.com
// https://www.youtube.com/channel/UC8nJI40ZJ2C682oAsB16gCA
//
//////////

#include "src/TUAbsMouse.h"


#define ALWAYS_INLINE inline __attribute__((always_inline))


// Handheld Mode Physical Resolution
const uint16_t HH_PHYSICAL_MAX_X = 1280;
const uint16_t HH_PHYSICAL_MAX_Y = 720;

// TV Mode Physical Resolution
const uint16_t TV_PHYSICAL_MAX_X = 1920;
const uint16_t TV_PHYSICAL_MAX_Y = 1080;


const uint8_t START_PIN = 2;


const uint8_t TEXTURE_NUM_PIXELS = 64;
const uint16_t IMAGE_DATA_LEN = (TEXTURE_NUM_PIXELS*TEXTURE_NUM_PIXELS)+1;
const PROGMEM uint8_t images[][IMAGE_DATA_LEN] =
{
  // Replace the example image data with your own image data below (from the generated CSV files).
  // See GBG_Texture_Builder in the `utils` folder.
  //
  // The data format is currently:
  // [0]      = Most common pixel color (used to fill background before drawing other pixels).
  // [1-4097] = [64][64] data [X][Y] representing the color of each pixel in the texture.
  //
  // EXAMPLES INCLUDED BELOW:
  // Author: LongToothGamer   Title: Test Diagnostic Pattern
  // Author: LongToothGamer   Title: Test Data Color Cube
  // Author: LongToothGamer   Title: Long Tooth Gamer Logo
  // Author: Colin Lloyd      Source: https://unsplash.com/photos/suj3od1uMv8
{
  // TEST DIAGNOSTIC PATTERN
  47,
  16,16,01,01,01,01,01,01,47,47,47,47,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16,
  16,16,01,01,01,47,47,47,47,47,47,47,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16,
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  32,32,02,02,47,47,47,47,47,47,47,47,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32,
},
{
  // TEST DATA COLOR CUBE
  0,27,27,27,27,27,27,27,27,27,27,27,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111
},
{
  // LONG TOOTH GAMER LOGO (LongToothGamer.com)
  0,47,47,47,47,47,47,47,47,47,47,47,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47
},
{
  // EYEBALL from Colin Lloyd on Unsplash
  74,87,14,132,42,87,87,59,42,132,42,132,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87
}
};
const uint8_t NUM_TEXTURES = sizeof(images)/IMAGE_DATA_LEN;


const uint8_t NUM_COLORS = 135;
bool usedColors[NUM_COLORS];


// the setup function runs once when you press reset or power the board
void setup()
{
  // Set up button, pullup opposite to active state
  pinMode(START_PIN, INPUT_PULLDOWN);

  TUAbsMouse.begin();

  Serial.begin(115200);

  // wait until device mounted
  while( !USBDevice.mounted() ) {
    delay(10);
  }

  Serial.println("Setup complete!");
}


void loop()
{
  // poll gpio once each 10 ms
  delay(10);

  // Whether button is pressed
  bool btn_pressed = (digitalRead(START_PIN) == HIGH);

  // indicate that we're alive and working
  digitalWrite(LED_BUILTIN, btn_pressed ? LOW : HIGH);

  // nothing to do if button is not pressed
  if (!btn_pressed) return;


  //////////


  if (!TUAbsMouse.ready()) return;


  //////////


  for (uint16_t n=0; n<NUM_TEXTURES; n++) {
    // Rehome for every texture in case the screen is accidentally touched
    TUAbsMouse.home();

    // Create a new Texture Nodon and get ready to plot the pixels
    createTextureNodon(n);

    // Reset the processed colors indicators
    resetUsedColors();

    // Get first color from the image data.
    // It represents the most used color and is used as the Background color.
    uint8_t baseColor = pgm_read_byte_near(&images[n][0]);

    // As new textures has a transparent background we don't have to fill-bucket the canvas if the most used color is "transparent"
    if (baseColor != 47) {
      pickColor(baseColor);               // Get color from the Palette
      TUAbsMouse.clickMouse(958, 268);    // Mouse click on "Bucket Tool"
      TUAbsMouse.clickMouse(820, 280);    // Fill the background on the canvas
      TUAbsMouse.clickMouse(991, 196);    // Mouse click on "Pencil Tool"
    }

    // Remember that we already used this color
    usedColors[baseColor] = true;

    if (n==0) {
      // Only click on pixel brush first time when creating multiple textures
      TUAbsMouse.clickMouse(940, 375);    // Mouse click on "Pixel Brush"
    }

    for (uint16_t t=1; t<IMAGE_DATA_LEN; t++) {
      // get the target pixel color from the image data at the current index
      uint8_t targetPixelColor = pgm_read_byte_near(&images[n][t]);

      // only process the color if we haven't already processed it
      if (!usedColors[targetPixelColor]) {
        // Remember that we already used/processed this color
        usedColors[targetPixelColor] = true;

        // Pick the color from the Palette
        pickColor(targetPixelColor);

        // go through the remaining rows - wrapping around at the end of each line
        for (uint16_t c=t; c<IMAGE_DATA_LEN; c++) {
          uint16_t cPosX = (c-1) % TEXTURE_NUM_PIXELS;
          if (cPosX == 0) {
            // release the button - at the start of a row
            TUAbsMouse.mouseButtonRelease();
          }

          uint8_t currentPixelColor = pgm_read_byte_near(&images[n][c]);
          if (currentPixelColor == targetPixelColor) {
            // move to the pixel location - current pixel location matches target
            uint16_t cPosY = (c-1) / TEXTURE_NUM_PIXELS;
            TUAbsMouse.moveTo(340+(cPosX*8), 158+(cPosY*8));

            // make sure the button is pressed - current pixel color matches
            TUAbsMouse.mouseButtonPress();
          } else {
            // release the button - current pixel color doesn't match
            TUAbsMouse.mouseButtonRelease();
          }
        }

        // make sure the mouse is released at the end of each color run
        TUAbsMouse.mouseButtonRelease();
      }
    }

    // Done with this Texture Nodon
    clickCloseWindow();

    // Let the display finish updating
    delay(500);
  }

  while(1) {
    // Turn LED on (LOW on Seeeduino XIAO)
    digitalWrite(LED_BUILTIN, LOW);
    delay(750);
    // Turn LED off (HIGH on Seeeduino XIAO)
    digitalWrite(LED_BUILTIN, HIGH);
    delay(750);
  }
}


//////////


ALWAYS_INLINE
void resetUsedColors() {
  memset(usedColors, false, sizeof(usedColors));
}

ALWAYS_INLINE
void clickCloseWindow() {
  // Click on the "X" to exit the currently open window
  TUAbsMouse.clickMouse(1222, 56);
}

ALWAYS_INLINE
void createTextureNodon(uint8_t n) {
  // Move to magnify plus button
  TUAbsMouse.moveTo(948, 694);

  if (n==0) {
    // assume the worst case on the first pass and zoom in enough to force the auto scale
    for (byte i=0; i<16; i++) {
      TUAbsMouse.clickMouse();
      delay(30); // extra delay to allow UI to update
    }
  } else {
    // after the first case we just need to magnify enough to cause the auto scale again
    for (byte i=0; i<3; i++) {
      TUAbsMouse.clickMouse();
      delay(30); // extra delay to allow UI to update
    }
  }

  TUAbsMouse.clickMouse(362, 692);      // Objects
  TUAbsMouse.clickMouse(362, 332);      // Special Objects
  TUAbsMouse.clickMouse(488, 572);      // Texture
  delay(500); // A delay that is required to be sure the nodon gear icon is being displayed
  TUAbsMouse.clickMouse(550, 575);      // Edit Texture Gear icon
}


ALWAYS_INLINE
void pickColor(int16_t color_pos) {
  int column = color_pos % 15;
  int row = color_pos / 15;
  int pos_x = 84+(column*48)+((column/3)*16);
  int pos_y = 175+(row*48)+((row/3)*16);

  TUAbsMouse.clickMouse(1187, 544);     // Mouse click to open "Palette gear tool/Colour Palette"
  TUAbsMouse.clickMouse(pos_x, pos_y);  // Move mouse to color coords. and click on it
  clickCloseWindow();
}
